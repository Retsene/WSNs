#include "eink_display.h"
#include <string.h>

extern SPI_HandleTypeDef hspi2;

static uint8_t fb[EINK_BUFF_SIZE];
static uint16_t e_w = EINK_WIDTH;
static uint16_t e_h = EINK_HEIGHT;

static const uint8_t font_8x6[96][6] = {
    {0x00,0x00,0x00,0x00,0x00,0x00}, /*   */
    {0x00,0x00,0x4F,0x00,0x00,0x00}, /* ! */
    {0x00,0x07,0x00,0x07,0x00,0x00}, /* " */
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    {0x44,0x64,0x54,0x4C,0x44,0x00}, /* z */
};

static void EINK_DC_CMD(void)
{
    HAL_GPIO_WritePin(EINK_D_C_GPIO_Port, EINK_D_C_Pin, GPIO_PIN_RESET);
}

static void EINK_DC_DATA(void)
{
    HAL_GPIO_WritePin(EINK_D_C_GPIO_Port, EINK_D_C_Pin, GPIO_PIN_SET);
}

static void EINK_CS_LOW(void)
{
    HAL_GPIO_WritePin(EINK_CS_GPIO_Port, EINK_CS_Pin, GPIO_PIN_RESET);
}

static void EINK_CS_HIGH(void)
{
    HAL_GPIO_WritePin(EINK_CS_GPIO_Port, EINK_CS_Pin, GPIO_PIN_SET);
}

static void EINK_SendCmd(uint8_t cmd)
{
    EINK_DC_CMD();
    EINK_CS_LOW();
    HAL_SPI_Transmit(&hspi2, &cmd, 1, 10);
    EINK_CS_HIGH();
    EINK_DC_DATA();
}

static void EINK_SendData(uint8_t data)
{
    EINK_CS_LOW();
    HAL_SPI_Transmit(&hspi2, &data, 1, 10);
    EINK_CS_HIGH();
}

static void EINK_SendDataBurst(uint8_t *data, uint16_t len)
{
    EINK_CS_LOW();
    HAL_SPI_Transmit(&hspi2, data, len, 1000);
    EINK_CS_HIGH();
}

static bool EINK_Busy(void)
{
    return (HAL_GPIO_ReadPin(EINK_BUSY_GPIO_Port, EINK_BUSY_Pin) == GPIO_PIN_SET);
}

static void EINK_WaitBusy(void)
{
    while (EINK_Busy())
    {
        HAL_Delay(1);
    }
}

static void EINK_Reset(void)
{
    HAL_GPIO_WritePin(EINK_RES_GPIO_Port, EINK_RES_Pin, GPIO_PIN_RESET);
    HAL_Delay(10);
    HAL_GPIO_WritePin(EINK_RES_GPIO_Port, EINK_RES_Pin, GPIO_PIN_SET);
    HAL_Delay(10);
}

static void EINK_SetCursorXY(uint16_t x, uint16_t y)
{
    EINK_SendCmd(0x4E);
    EINK_SendData(x & 0xFF);

    EINK_SendCmd(0x4F);
    EINK_SendData(y & 0xFF);
    EINK_SendData((y >> 8) & 0xFF);
}

bool EINK_Init(EINK_Config *cfg)
{
    e_w = cfg->width;
    e_h = cfg->height;

    EINK_Reset();

    EINK_SendCmd(0x12);
    HAL_Delay(10);
    EINK_WaitBusy();

    EINK_SendCmd(0x01);
    EINK_SendData(0xC7);
    EINK_SendData(0x00);
    EINK_SendData(0x01);

    EINK_SendCmd(0x11);
    EINK_SendData(0x01);

    EINK_SendCmd(0x44);
    EINK_SendData(0x00);
    EINK_SendData(0x18);

    EINK_SendCmd(0x45);
    EINK_SendData(0xC7);
    EINK_SendData(0x00);
    EINK_SendData(0x00);
    EINK_SendData(0x00);

    EINK_SendCmd(0x3C);
    EINK_SendData(0x05);

    EINK_SendCmd(0x18);
    EINK_SendData(0x80);

    EINK_SendCmd(0x21);
    EINK_SendData(0x00);
    EINK_SendData(0x80);

    EINK_SetCursorXY(0, 0);

    memset(fb, 0xFF, sizeof(fb));

    return true;
}

void EINK_Clear(void)
{
    memset(fb, 0xFF, sizeof(fb));
}

void EINK_Update(void)
{
    EINK_SetCursorXY(0, 0);
    EINK_SendCmd(0x24);
    EINK_SendDataBurst(fb, EINK_BUFF_SIZE);

    EINK_SetCursorXY(0, 0);
    EINK_SendCmd(0x26);
    EINK_SendDataBurst(fb, EINK_BUFF_SIZE);

    EINK_SendCmd(0x22);
    EINK_SendData(0xF4);
    EINK_SendCmd(0x20);
    EINK_WaitBusy();
}

void EINK_Sleep(void)
{
    EINK_SendCmd(0x22);
    EINK_SendData(0x83);
    EINK_SendCmd(0x20);
    EINK_WaitBusy();

    EINK_SendCmd(0x10);
    EINK_SendData(0x01);
}

void EINK_DrawString(int x, int y, const char *str, uint8_t size)
{
    while (*str)
    {
        if (size == 8 && x + 6 < e_w && y + 8 < e_h)
        {
            uint8_t c = (uint8_t)*str;
            if (c < ' ' || c > '~') c = ' ';
            c -= ' ';
            for (uint8_t i = 0; i < 6; i++)
            {
                uint8_t line = font_8x6[c][i];
                for (uint8_t m = 0; m < 8; m++)
                {
                    if (line & 0x01)
                    {
                        uint16_t px = x + i;
                        uint16_t py = y + m;
                        if (px < e_w && py < e_h)
                        {
                            uint32_t addr = (px / 8) + py * EINK_W_BUFF_SIZE;
                            fb[addr] &= ~(0x80 >> (px % 8));
                        }
                    }
                    line >>= 1;
                }
            }
            x += 6;
        }
        else
        {
            x += 6;
        }
        str++;
    }
}

void EINK_LoadImage(const uint8_t *image)
{
    memcpy(fb, image, EINK_BUFF_SIZE);
}
